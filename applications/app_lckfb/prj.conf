## CMakeLists.txt
```
#-------------------------------------------------------------------------------
# Zephyr Example Application
#
# Copyright (c) 2021 Nordic Semiconductor ASA
# SPDX-License-Identifier: Apache-2.0

cmake_minimum_required(VERSION 3.13.1)
find_package(Zephyr REQUIRED HINTS $ENV{ZEPHYR_BASE})

project(app LANGUAGES C)

#target_sources(app PRIVATE src/main.c)
#target_sources(app PRIVATE src/qmi8658_test.c)
target_sources(app PRIVATE src/es8311_test.c)
```

## Kconfig
```
# Copyright (c) 2021 Nordic Semiconductor ASA
# SPDX-License-Identifier: Apache-2.0
#
# This file is the application Kconfig entry point. All application Kconfig
# options can be defined here or included via other application Kconfig files.
# You can browse these options using the west targets menuconfig (terminal) or
# guiconfig (GUI).

menu "Zephyr"
source "Kconfig.zephyr"

config RESET_COUNTER_SW0
    bool "Use sw0 to reset counter"
    default y
    help
        Use sw0 to reset counter

endmenu

module = APP
module-str = APP
source "subsys/logging/Kconfig.template.log_config"
```

## sample.yaml
```
# This file is provided so that the application can be compiled using Twister,
# the Zephyr testing tool. In this file, multiple combinations can be specified,
# so that you can easily test all of them locally or in CI.
sample:
  description: Example application
  name: example-application
common:
  build_only: true
  integration_platforms:
    - esp32s3_lckfb
tests:
  app.default: {}
  app.debug:
    extra_overlay_confs:
      - debug.conf
```

## prj.conf
```kconfig
# Copyright (c) 2021 Nordic Semiconductor ASA
# SPDX-License-Identifier: Apache-2.0
#
# This file contains selected Kconfig options for the application.

CONFIG_PRINTK=y
CONFIG_GPIO=y

CONFIG_LOG=y
CONFIG_APP_LOG_LEVEL_DBG=y
CONFIG_GPIO_LOG_LEVEL_DBG=y

CONFIG_MAIN_STACK_SIZE=4096

CONFIG_DISPLAY=y
CONFIG_ST7789V=y
CONFIG_MIPI_DBI_SPI=y

CONFIG_SHELL=y

CONFIG_LV_Z_MEM_POOL_SIZE=16384
CONFIG_LV_Z_SHELL=y

CONFIG_LVGL=y
CONFIG_LV_USE_LOG=y
CONFIG_LV_USE_LABEL=y
CONFIG_LV_USE_ARC=y
CONFIG_LV_USE_MONKEY=y
CONFIG_LV_FONT_MONTSERRAT_14=y

CONFIG_SENSOR=y
CONFIG_SENSOR_LOG_LEVEL_DBG=y

CONFIG_PICOLIBC_IO_FLOAT=y

# es8311 Audio Codec support
CONFIG_I2S=y
CONFIG_AUDIO=y
CONFIG_AUDIO_CODEC=y
CONFIG_AUDIO_CODEC_LOG_LEVEL_DBG=y
```

## boards/esp32s3_lckfb_procpu_usb.overlay
```dts
/*
 * SPDX-License-Identifier: Apache-2.0
 */

/ {

};
```

## src/main.c
```c
/*
 * Copyright (c) 2018 Jan Van Winkel <jan.van_winkel@dxplore.eu>
 *
 * SPDX-License-Identifier: Apache-2.0
 */

#include <zephyr/device.h>
#include <zephyr/devicetree.h>
#include <zephyr/drivers/display.h>
#include <zephyr/drivers/gpio.h>
#include <lvgl.h>
#include <stdio.h>
#include <string.h>
#include <zephyr/kernel.h>
#include <lvgl_input_device.h>
#include <zephyr/drivers/pwm.h>
#include "lvgl_zephyr.h"

#include <zephyr/logging/log.h>
#include <zephyr/drivers/sensor.h>
LOG_MODULE_REGISTER(app, CONFIG_APP_LOG_LEVEL);

static uint32_t count;

static struct pwm_dt_spec pwm_bk = PWM_DT_SPEC_GET(DT_ALIAS(pwm_led_bk));

#ifdef CONFIG_RESET_COUNTER_SW0
static struct gpio_dt_spec button_gpio = GPIO_DT_SPEC_GET_OR(
    DT_ALIAS(sw0), gpios, {0});
static struct gpio_callback button_callback;

static void button_isr_callback(const struct device *port,
                                struct gpio_callback *cb,
                                uint32_t pins) {
    ARG_UNUSED(port);
    ARG_UNUSED(cb);
    ARG_UNUSED(pins);

    count = 0;
}
#endif /* CONFIG_RESET_COUNTER_SW0 */

#ifdef CONFIG_LV_Z_ENCODER_INPUT
static const struct device *lvgl_encoder =
        DEVICE_DT_GET(DT_COMPAT_GET_ANY_STATUS_OKAY(zephyr_lvgl_encoder_input));
#endif /* CONFIG_LV_Z_ENCODER_INPUT */

#ifdef CONFIG_LV_Z_KEYPAD_INPUT
static const struct device *lvgl_keypad =
        DEVICE_DT_GET(DT_COMPAT_GET_ANY_STATUS_OKAY(zephyr_lvgl_keypad_input));
#endif /* CONFIG_LV_Z_KEYPAD_INPUT */

static void lv_btn_click_callback(lv_event_t *e) {
    ARG_UNUSED(e);

    count = 0;
}

int main(void) {
    int ret;
    char count_str[11] = {0};
    const struct device *display_dev;
    lv_obj_t *hello_world_label;
    lv_obj_t *count_label;

    display_dev = DEVICE_DT_GET(DT_CHOSEN(zephyr_display));
    if (!device_is_ready(display_dev)) {
        LOG_ERR("Device not ready, aborting test");
        return 0;
    }

#ifdef CONFIG_RESET_COUNTER_SW0
    if (gpio_is_ready_dt(&button_gpio)) {
        int err;

        err = gpio_pin_configure_dt(&button_gpio, GPIO_INPUT);
        if (err) {
            LOG_ERR("failed to configure button gpio: %d", err);
            return 0;
        }

        gpio_init_callback(&button_callback, button_isr_callback,
                           BIT(button_gpio.pin));

        err = gpio_add_callback(button_gpio.port, &button_callback);
        if (err) {
            LOG_ERR("failed to add button callback: %d", err);
            return 0;
        }

        err = gpio_pin_interrupt_configure_dt(&button_gpio,
                                              GPIO_INT_EDGE_TO_ACTIVE);
        if (err) {
            LOG_ERR("failed to enable button callback: %d", err);
            return 0;
        }
    }
#endif /* CONFIG_RESET_COUNTER_SW0 */

#ifdef CONFIG_LV_Z_ENCODER_INPUT
    lv_obj_t *arc;
    lv_group_t *arc_group;

    arc = lv_arc_create(lv_screen_active());
    lv_obj_align(arc, LV_ALIGN_CENTER, 0, -15);
    lv_obj_set_size(arc, 150, 150);

    arc_group = lv_group_create();
    lv_group_add_obj(arc_group, arc);
    lv_indev_set_group(lvgl_input_get_indev(lvgl_encoder), arc_group);
#endif /* CONFIG_LV_Z_ENCODER_INPUT */

#ifdef CONFIG_LV_Z_KEYPAD_INPUT
    lv_obj_t *btn_matrix;
    lv_group_t *btn_matrix_group;
    static const char *const btnm_map[] = {"1", "2", "3", "4", ""};

    btn_matrix = lv_buttonmatrix_create(lv_screen_active());
    lv_obj_align(btn_matrix, LV_ALIGN_CENTER, 0, 70);
    lv_buttonmatrix_set_map(btn_matrix, (const char **) btnm_map);
    lv_obj_set_size(btn_matrix, 100, 50);

    btn_matrix_group = lv_group_create();
    lv_group_add_obj(btn_matrix_group, btn_matrix);
    lv_indev_set_group(lvgl_input_get_indev(lvgl_keypad), btn_matrix_group);
#endif /* CONFIG_LV_Z_KEYPAD_INPUT */

    if (IS_ENABLED(CONFIG_LV_Z_POINTER_INPUT)) {
        lv_obj_t *hello_world_button;

        hello_world_button = lv_button_create(lv_screen_active());
        lv_obj_align(hello_world_button, LV_ALIGN_CENTER, 0, -15);
        lv_obj_add_event_cb(hello_world_button, lv_btn_click_callback, LV_EVENT_CLICKED,
                            NULL);
        hello_world_label = lv_label_create(hello_world_button);
    } else {
        hello_world_label = lv_label_create(lv_screen_active());
    }

    lv_label_set_text(hello_world_label, "Hello world!");
    lv_obj_align(hello_world_label, LV_ALIGN_CENTER, 0, 0);

    count_label = lv_label_create(lv_screen_active());
    lv_obj_align(count_label, LV_ALIGN_BOTTOM_MID, 0, 0);

    LOG_INF("App started");

    lv_timer_handler();
    display_blanking_off(display_dev);

    if (!pwm_is_ready_dt(&pwm_bk)) {
        LOG_ERR("PWM device not ready");
        return -1;
    }
    ret = pwm_set_dt(&pwm_bk, PWM_MSEC(1),PWM_MSEC(1));
    if (ret != 0) {
        LOG_ERR("PWM device set failed");
        return -1;
    }

    while (1) {
        if ((count % 100) == 0U) {
            sprintf(count_str, "%d", count / 100U);
            lv_label_set_text(count_label, count_str);
        }
        lv_timer_handler();
        ++count;
        k_sleep(K_MSEC(10));
    }
}
```

## src/es8311_test.c
```c
#include <zephyr/kernel.h>
#include <zephyr/device.h>
#include <stdio.h>
#include <zephyr/logging/log.h>
#include <zephyr/audio/codec.h>
#include <zephyr/drivers/i2s.h>
#include <zephyr/drivers/gpio.h>
#include <string.h>
#include <math.h>

LOG_MODULE_REGISTER(app_main, CONFIG_APP_LOG_LEVEL);

/* Audio configuration parameters */
#define SAMPLE_FREQUENCY    16000  /* 16kHz sample rate */
#define SAMPLE_BIT_WIDTH    16     /* 16-bit samples */
#define BYTES_PER_SAMPLE    sizeof(int16_t)
#define NUMBER_OF_CHANNELS  2      /* Stereo output */
#define SAMPLES_PER_BLOCK   ((SAMPLE_FREQUENCY / 10) * NUMBER_OF_CHANNELS)  /* 100ms blocks */
#define BLOCK_SIZE          (BYTES_PER_SAMPLE * SAMPLES_PER_BLOCK)
#define BLOCK_COUNT         4
#define TIMEOUT_MS          1000

/* Memory slab for audio buffers */
K_MEM_SLAB_DEFINE_STATIC(tx_mem_slab, BLOCK_SIZE, BLOCK_COUNT, 4);

/* Generate a sine wave tone for testing audio output */
static void generate_tone(void *mem_block, uint32_t num_samples, uint32_t *phase, uint32_t frequency) {
    int16_t *samples = (int16_t *) mem_block;
    const int16_t amplitude = 8000; /* Amplitude (about 25% of max to avoid clipping) */

    for (uint32_t i = 0; i < num_samples; i += NUMBER_OF_CHANNELS) {
        /* Calculate sine wave sample */
        uint32_t angle = (*phase * frequency * 360) / SAMPLE_FREQUENCY;
        angle = angle % 360;

        /* Simple sine approximation (for demonstration) */
        double radians = (double) angle * 3.14159265359 / 180.0;
        int16_t sample = (int16_t) (amplitude * sin(radians));

        /* Write to both channels (stereo) */
        samples[i] = sample; /* Left channel */
        samples[i + 1] = sample; /* Right channel */

        (*phase)++;
        if (*phase >= SAMPLE_FREQUENCY) {
            *phase = 0;
        }
    }
}

int main(void) {
    int ret = 0;

    // Enable speaker en pin
    const struct gpio_dt_spec speaker_en = GPIO_DT_SPEC_GET_OR(DT_NODELABEL(speaker_en), gpios, {0});
    if (!gpio_is_ready_dt(&speaker_en)) {
        LOG_ERR("GPIO speaker_en not ready");
        return 0;
    }
    ret = gpio_pin_configure_dt(&speaker_en,GPIO_OUTPUT_ACTIVE);
    if (ret < 0) {
        LOG_ERR("GPIO speaker_en not configured");
        return 0;
    }

    printk("\n=== ES8311 Audio Output Test ===\n");

    /* Get the codec device */
    const struct device *codec = DEVICE_DT_GET_ONE(everest_es8311);
    if (!device_is_ready(codec)) {
        printk("ERROR: Codec device not ready\n");
        return -ENODEV;
    }
    printk("ES8311 codec ready\n");

    /* Get the I2S device */
    const struct device *i2s_dev = DEVICE_DT_GET(DT_ALIAS(i2s_txrx));
    if (!device_is_ready(i2s_dev)) {
        printk("ERROR: I2S device not ready\n");
        return -ENODEV;
    }
    printk("I2S device ready\n");

    /* Configure codec for audio playback (TX mode) */
    struct audio_codec_cfg codec_cfg = {
        .mclk_freq = 12288000, /* Typical MCLK for 16kHz (256 * 48kHz) */
        .dai_type = AUDIO_DAI_TYPE_I2S,
        .dai_route = AUDIO_ROUTE_PLAYBACK, /* Audio output mode */
        .dai_cfg = {
            .i2s = {
                .word_size = SAMPLE_BIT_WIDTH,
                .channels = NUMBER_OF_CHANNELS,
                .format = I2S_FMT_DATA_FORMAT_I2S,
                .options = I2S_OPT_FRAME_CLK_MASTER | I2S_OPT_BIT_CLK_MASTER,
                .frame_clk_freq = SAMPLE_FREQUENCY,
                .mem_slab = &tx_mem_slab,
                .block_size = BLOCK_SIZE,
                .timeout = TIMEOUT_MS,
            },
        },
    };

    ret = audio_codec_configure(codec, &codec_cfg);
    if (ret < 0) {
        printk("ERROR: Failed to configure codec: %d\n", ret);
        return ret;
    }
    printk("Codec configured: %dHz, %d-bit, %d channel(s)\n",
           SAMPLE_FREQUENCY, SAMPLE_BIT_WIDTH, NUMBER_OF_CHANNELS);

    /* Set output volume (adjust as needed, codec-specific values) */
    audio_property_value_t vol_val;
    vol_val.vol = 240; /* Set volume level (0-255, where 192=0dB, 240=+24dB) */
    ret = audio_codec_set_property(codec, AUDIO_PROPERTY_OUTPUT_VOLUME,
                                   AUDIO_CHANNEL_ALL, vol_val);
    if (ret == 0) {
        printk("Output volume set to %d\n", vol_val.vol);
    }

    /* Unmute output */
    audio_property_value_t mute_val;
    mute_val.mute = false;
    ret = audio_codec_set_property(codec, AUDIO_PROPERTY_OUTPUT_MUTE,
                                   AUDIO_CHANNEL_ALL, mute_val);
    if (ret == 0) {
        printk("Output unmuted\n");
    }

    /* Apply codec properties */
    audio_codec_apply_properties(codec);

    /* Configure I2S for TX (transmit/playback) */
    struct i2s_config i2s_cfg = {
        .word_size = SAMPLE_BIT_WIDTH,
        .channels = NUMBER_OF_CHANNELS,
        .format = I2S_FMT_DATA_FORMAT_I2S,
        .options = I2S_OPT_BIT_CLK_MASTER | I2S_OPT_FRAME_CLK_MASTER,
        .frame_clk_freq = SAMPLE_FREQUENCY,
        .mem_slab = &tx_mem_slab,
        .block_size = BLOCK_SIZE,
        .timeout = TIMEOUT_MS,
    };

    ret = i2s_configure(i2s_dev, I2S_DIR_TX, &i2s_cfg);
    if (ret < 0) {
        printk("ERROR: Failed to configure I2S TX: %d\n", ret);
        return ret;
    }
    printk("I2S TX configured\n");

    /* Tone generation parameters */
    uint32_t phase = 0;
    uint32_t tone_frequencies[] = {440, 880, 1320}; /* A4, A5, E6 notes */
    uint32_t current_freq_idx = 0;
    uint32_t blocks_per_tone = 30; /* 3 seconds per tone at 100ms blocks */
    uint32_t block_count = 0;

    /* Pre-fill the I2S TX queue with initial buffers before starting */
    printk("Pre-filling I2S TX buffers...\n");
    for (int i = 0; i < 2; i++) {
        void *mem_block;
        ret = k_mem_slab_alloc(&tx_mem_slab, &mem_block, K_MSEC(TIMEOUT_MS));
        if (ret < 0) {
            printk("ERROR: Failed to allocate initial buffer: %d\n", ret);
            return ret;
        }

        /* Generate initial tone data */
        generate_tone(mem_block, SAMPLES_PER_BLOCK, &phase, tone_frequencies[0]);

        /* Queue the buffer */
        ret = i2s_write(i2s_dev, mem_block, BLOCK_SIZE);
        if (ret < 0) {
            printk("ERROR: Failed to queue initial buffer: %d\n", ret);
            k_mem_slab_free(&tx_mem_slab, mem_block);
            return ret;
        }
    }
    printk("Initial buffers queued\n");

    /* Start I2S transmission */
    ret = i2s_trigger(i2s_dev, I2S_DIR_TX, I2S_TRIGGER_START);
    if (ret < 0) {
        printk("ERROR: Failed to start I2S TX: %d\n", ret);
        return ret;
    }
    printk("\n>>> Starting audio playback <<<\n");
    printk("Playing sine wave tones...\n\n");


    /* Main loop: Generate and send audio data */
    while (1) {
        void *mem_block;

        /* Allocate a memory block for audio data */
        ret = k_mem_slab_alloc(&tx_mem_slab, &mem_block, K_MSEC(TIMEOUT_MS));
        if (ret < 0) {
            printk("ERROR: Failed to allocate memory block: %d\n", ret);
            k_sleep(K_MSEC(100));
            continue;
        }

        /* Generate tone data */
        uint32_t current_freq = tone_frequencies[current_freq_idx];
        generate_tone(mem_block, SAMPLES_PER_BLOCK, &phase, current_freq);

        /* Write audio data to I2S */
        ret = i2s_write(i2s_dev, mem_block, BLOCK_SIZE);
        if (ret < 0) {
            printk("ERROR: Failed to write I2S data: %d\n", ret);
            k_mem_slab_free(&tx_mem_slab, mem_block);
            k_sleep(K_MSEC(100));
            continue;
        }

        block_count++;

        /* Change tone every N blocks */
        if (block_count % blocks_per_tone == 0) {
            current_freq_idx = (current_freq_idx + 1) % 3;
            phase = 0; /* Reset phase for clean transition */
            printk("Switching to %u Hz tone\n", tone_frequencies[current_freq_idx]);
        }

        /* Print status every 10 blocks (~1 second) */
        if (block_count % 10 == 0) {
            printk("Playing: %u Hz | Blocks sent: %u (%u.%u seconds)\n",
                   current_freq, block_count, block_count / 10, block_count % 10);
        }

        /* Optional: Add stop condition after some time or button press */
        // Can add stop condition here if needed
    }

    /* Stop I2S (unreachable in current loop, but shown for completeness) */
    i2s_trigger(i2s_dev, I2S_DIR_TX, I2S_TRIGGER_STOP);
    printk("Audio playback stopped\n");

    return 0;
}
```

## src/qmi8658_test.c
```c
#include <zephyr/kernel.h>
#include <zephyr/device.h>
#include <zephyr/drivers/sensor.h>
#include <stdio.h>
#include <zephyr/logging/log.h>
LOG_MODULE_REGISTER(app_main, CONFIG_APP_LOG_LEVEL);

int main(void) {
    const struct device *const dev = DEVICE_DT_GET_ONE(qst_qmi8658);
    struct sensor_value acc[3], gyr[3];
    struct sensor_value full_scale, sampling_freq;

    if (!device_is_ready(dev)) {
        LOG_ERR("Device %s is not ready\n", dev->name);
        return 0;
    }

    LOG_INF("Device %p name is %s\n", dev, dev->name);

    full_scale.val1 = 40; /* ms/s^2 */
    full_scale.val2 = 0;
    sampling_freq.val1 = 100; /* Hz. Performance mode */
    sampling_freq.val2 = 0;

    sensor_attr_set(dev, SENSOR_CHAN_ACCEL_XYZ, SENSOR_ATTR_FULL_SCALE,
                    &full_scale);
    /* Set sampling frequency last as this also sets the appropriate
     * power mode. If already sampling, change to 0.0Hz before changing
     * other attributes
     */
    sensor_attr_set(dev, SENSOR_CHAN_ACCEL_XYZ,
                    SENSOR_ATTR_SAMPLING_FREQUENCY,
                    &sampling_freq);

    /* Setting scale in degrees/s to match the sensor scale */
    full_scale.val1 = 1024; /* dps */
    full_scale.val2 = 0;
    sampling_freq.val1 = 100; /* Hz. Performance mode */
    sampling_freq.val2 = 0;

    sensor_attr_set(dev, SENSOR_CHAN_GYRO_XYZ, SENSOR_ATTR_FULL_SCALE,
                    &full_scale);
    /* Set sampling frequency last as this also sets the appropriate
     * power mode. If already sampling, change sampling frequency to
     * 0.0Hz before changing other attributes
     */
    sensor_attr_set(dev, SENSOR_CHAN_GYRO_XYZ,
                    SENSOR_ATTR_SAMPLING_FREQUENCY,
                    &sampling_freq);

    while (1) {
        /* 10ms period, 100Hz Sampling frequency */
        k_sleep(K_MSEC(50));

        sensor_sample_fetch(dev);

        sensor_channel_get(dev, SENSOR_CHAN_ACCEL_XYZ, acc);
        sensor_channel_get(dev, SENSOR_CHAN_GYRO_XYZ, gyr);

        printf("%f,%f,%f,"
               "%f,%f,%f\n",
               sensor_value_to_double(&acc[0]),
               sensor_value_to_double(&acc[1]),
               sensor_value_to_double(&acc[2]),
               sensor_value_to_double(&gyr[0]),
               sensor_value_to_double(&gyr[1]),
               sensor_value_to_double(&gyr[2]));
    }
    return 0;
}
```
