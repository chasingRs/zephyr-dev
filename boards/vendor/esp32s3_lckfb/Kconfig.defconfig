## boards/vendor/esp32s3_lckfb/Kconfig.defconfig
```kconfig
if DISPLAY
# choice ST7789V_PIXEL_FORMAT
# 	default ST7789V_RGB565
#
# endchoice

if LVGL

config LV_Z_BITS_PER_PIXEL
	default 16

choice LV_COLOR_DEPTH
	default LV_COLOR_DEPTH_16
endchoice

endif # LVGL

endif # DISPLAY

if GPIO_PCA_SERIES
    config GPIO_PCA_SERIES_INIT_PRIORITY
        default 50

    config GPIO_PCA_SERIES_INTERRUPT
        default n

    config GPIO_PCA_SERIES_CACHE_ALL
        default n
endif
```

## boards/vendor/esp32s3_lckfb/Kconfig.esp32s3_lckfb
```kconfig
# SPDX-License-Identifier: Apache-2.0

config BOARD_ESP32S3_LCKFB
	select SOC_ESP32S3_MINI_N8
	select SOC_ESP32S3_PROCPU if BOARD_ESP32S3_LCKFB_ESP32S3_PROCPU || BOARD_ESP32S3_LCKFB_ESP32S3_PROCPU_USB
	select SOC_ESP32S3_APPCPU if BOARD_ESP32S3_LUATOS_CORE_SIMPLE_ESP32S3_APPCPU || BOARD_ESP32S3_LCKFB_ESP32S3_APPCPU_USB
```

## boards/vendor/esp32s3_lckfb/board.yml
```yaml
board:
  name: esp32s3_lckfb
  full_name: ESP32S3-Lckfb
  vendor: luatos
  socs:
    - name: esp32s3
      variants:
        - name: usb
          cpucluster: procpu
        - name: usb
          cpucluster: appcpu
```

## boards/vendor/esp32s3_luatos_core_simple/board.yml
```yaml
board:
  name: esp32s3_luatos_core_simple
  full_name: ESP32S3-Luatos-Core-Self-Modified
  vendor: luatos
  socs:
    - name: esp32s3
      variants:
        - name: usb
          cpucluster: procpu
        - name: usb
          cpucluster: appcpu
```

## drivers/audio/es8311/Kconfig
```kconfig
# SPDX-License-Identifier: Apache-2.0
#
# ES8311 Audio Codec configuration options

config ES8311
	bool "ES8311 Audio Codec"
	default y
	select I2C
	depends on DT_HAS_EVEREST_ES8311_ENABLED
	help
	  Enable support for the Everest Semiconductor ES8311 audio codec.
	  This is a low power mono audio codec with integrated headphone
	  amplifier.

if ES8311

config ES8311_INIT_PRIORITY
	int "ES8311 initialization priority"
	default 80
	help
	  ES8311 device driver initialization priority. The priority must be
	  lower than I2C_INIT_PRIORITY.

endif # ES8311
```

## drivers/sensor/Kconfig
```kconfig
# Copyright (c) 2021 Nordic Semiconductor ASA
# SPDX-License-Identifier: Apache-2.0

if SENSOR
rsource "example_sensor/Kconfig"
rsource "qmi8658/Kconfig"
endif # SENSOR
```

## drivers/sensor/qmi8658/Kconfig
```kconfig
# Copyright (c) 2021 Nordic Semiconductor ASA
# SPDX-License-Identifier: Apache-2.0

config QMI8658
	bool "QMI8658 sensor support"
	default y
	depends on DT_HAS_QST_QMI8658_ENABLED
	select GPIO
	help
	  Enable QMI8658 sensor
```

## dts/bindings/audio/everest,es8311.yaml
```yaml
description: Everest ES8311 Audio Codec

compatible: "everest,es8311"

include: [i2c-device.yaml]

properties:
  "#address-cells":
    const: 1

  "#size-cells":
    const: 0

  clocks:
    required: false
    description: |
      Optional clock controller for MCLK. If provided, the driver will
      query the clock rate. If not provided, MCLK frequency must be
      specified via mclk-frequency property or BCLK will be used as
      internal MCLK in consumer mode.

  clock-names:
    description: |
      Should be "mclk" if clocks property is used.

  mclk-frequency:
    type: int
    required: false
    description: |
      Master clock (MCLK) frequency in Hz. Use this if MCLK is provided
      by an I2S controller or external oscillator that doesn't have a
      clock controller driver. Common values are 11289600, 12288000,
      18432000, or 24576000 Hz.
```

## dts/bindings/sensor/qst,qmi8658.yaml
```yaml
title: "QST QMI8658 Motion Tracking Device"
description: qmi8658 motion tracking device

compatible: "qst,qmi8658"

include: [i2c-device.yaml, "sensor-device.yaml"]

properties:
  int-gpios:
    type: phandle-array
    description: |
      The INT signal default configuration is active-high. The
      property value should ensure the flags properly describe the
      signal that is presented to the driver.

  accel-hz:
    type: int
    required: true
    description: |
      Default frequency of accelerometer. (Unit - Hz)
      Maps to ACCEL_ODR field in ACCEL_CONFIG0 setting
      Power-on reset value is 1000.
    enum:
      - 25
      - 50
      - 100
      - 200
      - 500
      - 1000
      - 2000
      - 4000
      - 8000

  gyro-hz:
    type: int
    required: true
    description: |
      Default frequency of gyroscope. (Unit - Hz)
      Maps to GYRO_ODR field in GYRO_CONFIG0 setting
      Power-on reset value is 1000.
    enum:
      - 25
      - 50
      - 100
      - 200
      - 500
      - 1000
      - 2000
      - 4000
      - 8000

  accel-fs:
    type: int
    required: true
    description: |
      Default full scale of accelerometer. (Unit - g)
      Maps to ACCEL_FS_SEL field in ACCEL_CONFIG0 setting
      Power-on reset value is 16
    enum:
      - 16
      - 8
      - 4
      - 2

  gyro-fs:
    type: int
    required: true
    description: |
      Default full scale of gyroscope. (Unit - DPS)
      Maps to GYRO_FS_SEL field in GYRO_CONFIG0 setting
      Power-on reset value is 2000
    enum:
      - 2048
      - 1024
      - 512
      - 256
      - 128
      - 64
      - 32
      - 16
```
