/* SPDX-License-Identifier: Apache-2.0 */
/*
 * Example Device Tree Overlay for ES8311 Audio Codec
 *
 * This overlay demonstrates how to configure the ES8311 codec
 * on an I2C bus with optional MCLK clock source.
 */

&i2c0 {
	status = "okay";

	es8311: es8311@18 {
		compatible = "everest,es8311";
		reg = <0x18>;
		status = "okay";

		/* Optional: MCLK clock source
		 * Uncomment and adjust if your hardware provides MCLK
		 * from a clock controller
		 */
		// clocks = <&clk_mclk>;
		// clock-names = "mclk";
	};
};

/* Example with MCLK from a clock controller */
/*
&i2c1 {
	status = "okay";

	es8311_with_mclk: es8311@19 {
		compatible = "everest,es8311";
		reg = <0x19>;
		status = "okay";
		clocks = <&audio_clk 0>;
		clock-names = "mclk";
	};
};
*/

